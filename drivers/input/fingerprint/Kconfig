## drivers/input/fingerprint/Kconfig
```kconfig
#
#Fingerprint
#
menu "Fingerprint support"
	depends on INPUT

config MTK_FINGERPRINT_SUPPORT
	bool "Mediatek Fingerprint"
	default n
	---help---
	Fingerprint mtk driver enable/disable in the kernel.
	Say Y here if you want to use mediatek fingerprint driver,
	fingerprint driver will support fingerprint function

if MTK_FINGERPRINT_SUPPORT

config FINGERPRINT_GT368
	bool "goodix gx368 Fingerprint"
	default y

config FINGERPRINT_GT368_OTP_X32
	bool "goodix gx368 otp Fingerprint"
	default n

config FINGERPRINT_GT368_OTP
	bool "goodix gx368 otp Fingerprint"
	default n

config FINGERPRINT_MICROARRAY
	bool "Microarray for Goodix Fingerprint"
	default n

config GOODIX_SENSOR_TYPE
	string "SENSOR_TYPE"
	default "GF3208"
	---help---
	Must input sensor type, or default is GF316M GF318M GF3118M GF518M GF5118M GF516M GF816M GF3208 GF5216
endif
endmenu
```

## drivers/input/touchscreen/mediatek/GT9XX/Kconfig
```kconfig
#
# Touchscreen driver configuration
#
config TOUCHSCREEN_MTK_GT9XX
	tristate "GT9XX for Mediatek package"
	default y
	help
	  Say Y here if you have GT9XX touch panel.

	  If unsure, say Y.

	  To compile this dirver as a module, choose M here: the
	  module will be called.

config GT9XX_FIRMWARE
	string "GT9XX for Mediatek firmware"
	default "firmware_default"

config GT9XX_CONFIG
	string "GT9XX for Mediatek config"
	default "config_default"

config GTP_COMPATIBLE_MODE
	bool "GTP_COMPATIBLE_MODE"
	default y
	help
	  Say Y here if you have GT9XX touch panel GTP_COMPATIBLE_MODE.

	  If unsure, say Y.

	  To compile this dirver as a module, choose M here: the
	  module will be called.

config GTP_GESTURE_WAKEUP
	bool "GTP_GESTURE_WAKEUP"
	default y
	help
	  Say Y here if you have GT9XX touch panel GTP_GESTURE_WAKEUP.

	  If unsure, say Y.

	  To compile this dirver as a module, choose M here: the
	  module will be called.

config GTP_POWER_CTRL_SLEEP
	bool "GTP_POWER_CTRL_SLEEP"
	default y
	help
	  Say Y here if you have GT9XX touch panel GTP_POWER_CTRL_SLEEP.

	  If unsure, say Y.

	  To compile this dirver as a module, choose M here: the
	  module will be called.

config GTP_ESD_PROTECT
	bool "GTP_ESD_PROTECT"
	default y
	help
	Say Y here if you have GT9XX_hotknot touch panel GTP_ESD_PROTECT.

config GTP_CREATE_WR_NODE
	bool "GTP_CREATE_WR_NODE"
	default y
	help
	  Say Y here if you have GT9XX touch panel GTP_CREATE_WR_NODE.

	  If unsure, say Y.

	  To compile this dirver as a module, choose M here: the
	  module will be called.

config GTP_DRIVER_SEND_CFG
	bool "GTP_DRIVER_SEND_CFG"
	default n
	help
	  Say Y here if you have GT9XX touch panel GTP_DRIVER_SEND_CFG.

	  If unsure, say N.

	  To compile this dirver as a module, choose M here: the
	  module will be called.

config GTP_CUSTOM_CFG
	bool "GTP_CUSTOM_CFG"
	default n
	help
	  Say Y here if you have GT9XX touch panel GTP_CUSTOM_CFG.

	  If unsure, say N.

	  To compile this dirver as a module, choose M here: the
	  module will be called.

config GTP_FW_DOWNLOAD
	bool "GTP_FW_DOWNLOAD"
	default n
	help
	  Say Y here if you have GT9XX touch panel GTP_FW_DOWNLOAD.

	  If unsure, say N.

	  To compile this dirver as a module, choose M here: the
	  module will be called.

config GTP_AUTO_UPDATE
	bool "GTP_AUTO_UPDATE"
	default n
	help
	  Say Y here if you have GT9XX touch panel GTP_AUTO_UPDATE.

	  If unsure, say N.

	  To compile this dirver as a module, choose M here: the
	  module will be called.

config GTP_HEADER_FW_UPDATE
	bool "GTP_HEADER_FW_UPDATE"
	default n
	help
	  Say Y here if you have GT9XX touch panel GTP_HEADER_FW_UPDATE.

	  If unsure, say N.

	  To compile this dirver as a module, choose M here: the
	  module will be called.

config GTP_AUTO_UPDATE_CFG
	bool "GTP_AUTO_UPDATE_CFG"
	default n
	help
	  Say Y here if you have GT9XX touch panel GTP_AUTO_UPDATE_CFG.

	  If unsure, say N.

	  To compile this dirver as a module, choose M here: the
	  module will be called.

config GTP_CHARGER_SWITCH
	bool "GTP_CHARGER_SWITCH"
	default n
	help
	  Say Y here if you have GT9XX touch panel GTP_CHARGER_SWITCH.

	  If unsure, say N.

	  To compile this dirver as a module, choose M here: the
	  module will be called.

config GTP_SUPPORT_I2C_DMA
	bool "GTP_SUPPORT_I2C_DMA"
	default n
	help
	  Say Y here if you have GT9XX touch panel GTP_SUPPORT_I2C_DMA.

	  If unsure, say N.

	  To compile this dirver as a module, choose M here: the
	  module will be called.

config GTP_WITH_PEN
	bool "GTP_WITH_PEN"
	default n
	help
	  Say Y here if you have GT9XX touch panel GTP_WITH_PEN.

	  If unsure, say N.

	  To compile this dirver as a module, choose M here: the
	  module will be called.

config GTP_SLIDE_WAKEUP
	bool "GTP_SLIDE_WAKEUP"
	default n
	help
	  Say Y here if you have GT9XX touch panel GTP_SLIDE_WAKEUP.

	  If unsure, say N.

	  To compile this dirver as a module, choose M here: the
	  module will be called.

config GTP_DBL_CLK_WAKEUP
	bool "GTP_DBL_CLK_WAKEUP"
	default n
	help
	  Say Y here if you have GT9XX touch panel GTP_DBL_CLK_WAKEUP.

	  If unsure, say N.

	  To compile this dirver as a module, choose M here: the
	  module will be called.

config GTP_HAVE_TOUCH_KEY
	bool "GTP_HAVE_TOUCH_KEY"
	default n
	help
	  Say Y here if you have GT9XX touch panel GTP_HAVE_TOUCH_KEY.

	  If unsure, say N.

	  To compile this dirver as a module, choose M here: the
	  module will be called.


config HOTKNOT_BLOCK_RW
	bool "HOTKNOT_BLOCK_RW"
	default n
	help
	  Say Y here if you have GT9XX touch panel HOTKNOT_BLOCK_RW.

	  If unsure, say N.

	  To compile this dirver as a module, choose M here: the
	  module will be called.

config TPD_PROXIMITY
	bool "TPD_PROXIMITY"
	default n
	help
	  Say Y here if you have GT9XX touch panel TPD_PROXIMITY.

	  If unsure, say N.

	  To compile this dirver as a module, choose M here: the
	  module will be called.
```

## drivers/misc/mediatek/lens/Kconfig
```kconfig
config MTK_LENS
  bool CONFIG_MTK_LENS
  default n
  help
    CONFIG_MTK_LENS

config MTK_LENS_USE_MODULE
  bool "Mediatek lens driver build as module"
  default n
  help
    Say Y here if you want to build touch driver as xxx.ko.

    If unsure, say N.

    To compile this dirver as a module,
    It will be called by insmod xxx.ko in init.rc.

#
# LENS
#

config MTK_LENS_DUMMYLENS_SUPPORT
  bool "Dummy Lens Driver"
  default n
  help
    Dummy Lens Driver
    This config is used to enable the corresponding
    lens driver for the camera sensor module
    Set as y if the driver is used in this project


config MTK_LENS_DW9714AF_SUPPORT
  bool "DW9714AF Lens Driver"
  default n
  help
    DW9714AF Lens Driver
    This config is used to enable the corresponding
    lens driver for the camera sensor module
    Set as y if the driver is used in this project
```
